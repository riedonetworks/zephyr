/* SPDX-License-Identifier: Apache-2.0 */

&spi3 {
	status = "okay";

	ili9340@0 {
		compatible = "ilitek,ili9340";
		label = "DISPLAY";
		spi-max-frequency = <50000000>;
		reg = <0>;
		reset-gpios = <&gpio1 18 0>;
		cmd-data-gpios = <&gpio1 19 0>;
	};
};

&gpio3 {
	status = "okay";
};


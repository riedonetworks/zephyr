## drivers/display/Kconfig.ili9340
```kconfig
# ILI9340 display driver configuration options

# Copyright (c) 2017 Jan Van Winkel <jan.van_winkel@dxplore.eu>
# SPDX-License-Identifier: Apache-2.0

menuconfig ILI9340
	bool "ILI9340 display driver"
	help
	  Enable driver for ILI9340 display driver.

if ILI9340

choice ILI9340_LCD
	prompt "LCD"
	default ILI9340_LCD_ADAFRUIT_1480
	help
	  Specify the type of LCD connected to the ILI9340 display controller.

config ILI9340_LCD_ADAFRUIT_1480
	bool "Adafruit 2.2\" TFT 1480"

config ILI9340_LCD_SEEED_TFTV2
	bool "Seeed 2.8\" TFT v2.0"

config ILI9340_LCD_WINSTAR_WF24LTYAJDNN0
	bool "Winstar WF24LTYAJDNN0"

config ILI9340_LCD_TIANMA_TM024HDH49
	bool "Tianma TM024HDH49"

endchoice

choice ILI9340_PIXEL_FORMAT
	prompt "Color pixel format"
	help
	  Specify the color pixel format of the ILI9340 display controller.

config ILI9340_RGB888
	bool "RGB888"

config ILI9340_RGB565
	bool "RGB565"

endchoice

choice ILI9340_IFACE
	prompt "display interface"
	default ILI9340_SPI
	help
	  Specify the MCU interface to use.

config ILI9340_SPI
	bool "SPI"
	depends on SPI

config ILI9340_PARALLEL
	depends on SOC_SERIES_IMX_RT
	bool "8-bit 8080 parallel interface"
	help
	  For display connected to the Smart External Memory Controller (SEMC)
	  of i.MX RT SoC.

endchoice

config ILI9340_INIT_PRIORITY
	int "Init priority"
	default 90
	help
	  Device driver initialization priority.
	  If device is connected to SPI bus, it has to
	  be initialized after SPI driver.

endif # ILI9340
```

## drivers/display/Kconfig.st7789v
```kconfig
# ST7789V display driver configuration options

# Copyright (c) 2019 Marc Reilly <marc@cpdesign.com.au>
# SPDX-License-Identifier: Apache-2.0

menuconfig ST7789V
	bool "ST7789V display driver"
	help
	  Enable driver for ST7789V display driver.

if ST7789V

choice ST7789V_LCD
	prompt "LCD"
	depends on ST7789V
	help
	  Specify the type of LCD connected to the ST7789V display controller.

config ST7789V_LCD_TL019FQV01
	bool "TDO TL019FQV01"

config ST7789V_LCD_FG0204L0DSSWMG01
	bool "Dataimage FG0204L0DSSWMG01"

config ST7789V_LCD_TL024QVV09
	bool "Top Display TL024QVV09"

endchoice

choice ST7789V_IFACE
	prompt "display interface"
	default ST7789V_SPI
	help
	  Specify the MCU interface to use.

config ST7789V_SPI
	depends on SPI
	bool "SPI"

config ST7789V_PARALLEL
	depends on SOC_SERIES_IMX_RT
	bool "8-bit 8080 parallel interface"
	help
	  For display connected to the Smart External Memory Controller (SEMC)
	  of i.MX RT SoC.

endchoice

choice ST7789V_PIXEL_FORMAT
	prompt "Color pixel format"
	default ST7789V_RGB565
	depends on ST7789V
	help
	  Specify the color pixel format for the ST7789V display controller.

config ST7789V_RGB888
	bool "RGB888"

config ST7789V_RGB565
	bool "RGB565"

endchoice

endif # ST7789V
```

## drivers/flash/Kconfig.flexspi_nor
```kconfig
#
# Copyright (c) 2020 Riedo Networks Ltd.
#
# SPDX-License-Identifier: Apache-2.0
#

menuconfig FLEXSPI_NOR_FLASH
	bool "SPI NOR flash controlled by FlexSPI"
	depends on SOC_SERIES_IMX_RT
	select FLASH_HAS_DRIVER_ENABLED
	select FLASH_HAS_PAGE_LAYOUT

if FLEXSPI_NOR_FLASH

config FLEXSPI_NOR_FLASH_INIT_PRIORITY
	int
	default 80
	help
	  Device driver initialization priority.
	  Device is connected to (Flex)SPI bus, it has to
	  be initialized after FlexSPI driver.

endif
```

## drivers/flexspi/Kconfig
```kconfig
#
# Copyright (c) 2020, Riedo Networks Ltd.
#
# SPDX-License-Identifier: Apache-2.0
#

#
# FlexSPI Drivers
#
menuconfig FLEXSPI
	bool "FlexSPI hardware bus support"
	help
	  Enable support for the FlexSPI hardware bus.

if FLEXSPI

config FLEXSPI_INIT_PRIORITY
	int "Init priority"
	default 70
	help
	  Device driver initialization priority.

source "drivers/flexspi/Kconfig.imx"

endif # FLEXSPI
```

## drivers/flexspi/Kconfig.imx
```kconfig
#
# Copyright (c) 2020, Riedo Networks Ltd.
#
# SPDX-License-Identifier: Apache-2.0
#

menuconfig FLEXSPI_IMX
	bool "i.MX RT FlexSPI driver"
	depends on SOC_SERIES_IMX_RT
	help
	  FlexSPI driver for the i.MX RT SOC family.
```

## drivers/serial/Kconfig.mcux_flexio
```kconfig
# Kconfig - MCUXpresso SDK LPUART
#
# Copyright (c) 2017, NXP
#
# SPDX-License-Identifier: Apache-2.0
#

menuconfig UART_MCUX_FLEXIO
	bool "MCUX FlexIO driver"
	depends on HAS_MCUX_LPUART && CLOCK_CONTROL && SOC_SERIES_IMX_RT
	select SERIAL_HAS_DRIVER
	select SERIAL_SUPPORT_INTERRUPT
	# select SERIAL_SUPPORT_ASYNC
	select INIT_USB1_PLL
	help
	  Enable the MCUX FlexIO driver.
	  This Driver emulate UART protocol using FlexIO periferal.

if UART_MCUX_FLEXIO

config UART_MCUX_FLEXIO_UART_1
	bool "UART on FlexIO 1"
	help
	  Enable UART on FlexIO 1.

config UART_MCUX_FLEXIO_UART_2
	bool "UART on FlexIO 2"
	help
	  Enable UART on FlexIO 2.



endif # UART_MCUX_FLEXIO
```

## dts/bindings/display/ilitek,ili9340,parallel.yaml
```yaml
# Copyright (c) 2018, Jan Van Winkel <jan.van_winkel@dxplore.eu>
# Copyright (C) 2020, Riedo Networks
# SPDX-License-Identifier: Apache-2.0

description: ILI9340 320x240 Display Controller

compatible: "ilitek,ili9340,parallel"

include: base.yaml

properties:
    reset-gpios:
      type: phandle-array
      required: false
      description: RESET pin.

        The RESET pin of ILI9340 is active low.
        If connected directly the MCU pin should be configured
        as active low.

    blon-gpios:
      type: phandle-array
      required: true
      description: Backlight ON pin.
```

## dts/bindings/display/sitronix,st7789v,parallel.yaml
```yaml
# Copyright (c) 2019, Marc Reilly <marc@cpdesign.com.au>
# Copyright (C) 2020, Riedo Networks
# SPDX-License-Identifier: Apache-2.0

description: ST7789V 320x240 display controller

compatible: "sitronix,st7789v,parallel"

include: base.yaml

properties:
    reset-gpios:
      type: phandle-array
      required: true
      description: RESET pin.

        The RESET pin of ST7789V is active low.
        If connected directly the MCU pin should be configured
        as active low.

    blon-gpios:
      type: phandle-array
      required: true
      description: Backlight ON pin.

    height:
      type: int
      required: true
      description: Height in pixels of the panel driven by the controller

    width:
      type: int
      required: true
      description: Width in pixels of the panel driven by the controller

    x-offset:
      type: int
      required: false
      description: The column offset in pixels of the LCD to the controller memory

    y-offset:
      type: int
      required: false
      description: The row offset in pixels of the LCD to the controller memory
```

## dts/bindings/ethernet/nxp,kinetis-ethernet.yaml
```yaml
# Copyright (c) 2018, Linaro Limited
# SPDX-License-Identifier: Apache-2.0

description: NXP Kinetis Ethernet

compatible: "nxp,kinetis-ethernet"

include: ethernet.yaml

properties:
    reg:
      required: true
    interrupts:
      required: true

    phy-management-interface:
      type: string
      required: false
      description: Select the PHY management interface.
      default: "MDIO"
      enum:
          - "MDIO"
          - "None"
```

## dts/bindings/mtd/flexspi,nor-flash.yaml
```yaml
# Copyright (c) 2020, Riedo Networks Ltd
# SPDX-License-Identifier: Apache-2.0

title: NOR FLASH controlled through FlexSPI

description: >
  This binding gives a base representation of SPI slave NOR FLASH

compatible: "flexspi,nor-flash"

include: "spi-device.yaml"

properties:

  jedec-id:
    type: uint8-array
    required: true
    description: "JEDEC ID as manufacturer ID, memory type, memory density."

  spi-access-mode:
    type: string
    required: true
    description: "SPI access mode. Supported modes depend on the flash model."
    enum:
      - single
      - dual
      - quad
      - qpi
```

## dts/bindings/mtd/flexspi,winbond,w25q128.yaml
```yaml
# Copyright (c) 2020, Riedo Networks Ltd
# SPDX-License-Identifier: Apache-2.0

description: winbond W25Q128 NOR FLASH

  winbond W25Q128 NOR FLASH controlled through FlexSPI

compatible: "flexspi,winbond,w25q128"

include: "flexspi,nor-flash.yaml"

properties:
  model:
    type: string
    required: true
    const: W25Q128
    description: "Flash model."
```

## dts/bindings/mtd/flexspi,winbond,w25q256.yaml
```yaml
# Copyright (c) 2020, Riedo Networks Ltd
# SPDX-License-Identifier: Apache-2.0

title: winbond W25Q256 NOR FLASH

description: >
  winbond W25Q256 NOR FLASH controlled through FlexSPI

compatible: "flexspi,winbond,w25q256"

include: "flexspi,nor-flash.yaml"

properties:
  model:
    type: string
    required: true
    const: W25Q256
    description: "Flash model."
```

## dts/bindings/serial/nxp,imxrt-flexio-uart.yaml
```yaml
# Copyright (C) 2020, Riedo Networks
# SPDX-License-Identifier: Apache-2.0

description: Kinetis LPUART

  This binding gives a representation of the FlexIO periferal in UART mode.

compatible: "nxp,imxrt-flexio-uart"

include: uart-controller.yaml

properties:
    reg:
      required: true

    interrupts:
      required: true

    clocks:
      required: true

    clock-config:
      type: array
      required: false
      default: [3, 2, 8]
      description: Clock Mux, Pre-Divider and Divider setting in one array.

    txd-signal:
      type: int
      required: true
      description: FlexIO FXIO_Dn singal to use for the Tx data signal

    txclk-signal:
      type: int
      required: false
      description: FlexIO FXIO_Dn singal to use for the Tx clock signal

    rxd-signal:
      type: int
      required: true
      description: FlexIO FXIO_Dn singal to use for the Rx data signal

    rxclk-signal:
      type: int
      required: false
      description: FlexIO FXIO_Dn singal to use for the Rx clock signal
```

## west.yml
```yaml
# The west manifest file for upstream Zephyr.
#
# The per-installation west configuration file, .west/config, sets the
# path to the project containing this file in the [manifest] section's
# "path" variable.
#
# You are free to create your own manifest files and put them in any
# repository you want, to create your own custom Zephyr installations.
# For example, you could create a manifest file in your own out of
# tree application directory, which would pull this zephyr repository
# in as an ordinary project.
#
# You can pass your manifest repositories to west init when creating a
# new Zephyr installation. See the west documentation for more
# information.

manifest:
  defaults:
    remote: upstream

  remotes:
    - name: upstream
      url-base: https://github.com/zephyrproject-rtos
    - name: origin
      url-base: ssh://git@git.riedo.com:10022
  #
  # Please add items below based on alphabetical order
  projects:
    - name: canopennode
      path: modules/lib/canopennode
      revision: 5c6b0566d56264efd4bf23ed58bc7cb8b32fe063
    - name: ci-tools
      revision: 0706b1e8be917b80e50be6e8cd86befe5e9deccf
      path: tools/ci-tools
    - name: civetweb
      revision: 99129c5efc907ea613c4b73ccff07581feb58a7a
      path: modules/lib/civetweb
    - name: fatfs
      revision: 9ee6b9b9511151d0d64a74d532d39c6f2bbd4f16
      path: modules/fs/fatfs
    - name: lvgl
      revision: 74fc2e753a997bd71cefa34dd9c56dcb954b42e2
      path: modules/lib/gui/lvgl
    - name: mbedtls
      revision: cf7020eb4c7ef93319f2d6d2403a21e12a879bf6
      path: modules/crypto/mbedtls
    - name: oss/mcuboot
      revision: f5d48aeb235890efd9bf4df32d5378739ec21139
      path: bootloader/mcuboot
      remote: origin
    - name: mcumgr
      revision: d4e97cd4fc80ff949415062b1c83fd42929e8fe4
      path: modules/lib/mcumgr
    - name: net-tools
      revision: 4bff01084d225996e4aae84b98be5969e2f9f33d
      path: tools/net-tools
    - name: oss/hal_nxp
      revision: bf9780c03b17bc05f85a1287df54ffbcf4f0e4fb
      path: modules/hal/nxp
      remote: origin
    - name: open-amp
      revision: 9b591b289e1f37339bd038b5a1f0e6c8ad39c63a
      path: modules/lib/open-amp
    - name: loramac-node
      revision: 29e516ec585b1a909af2b5f1c60d83e7d4d563e3
      path: modules/lib/loramac-node
    - name: openthread
      revision: 3c6191eb4e8ca44b5f4eeaa696837bce14e83c69
      path: modules/lib/openthread
    - name: segger
      revision: 6fcf61606d6012d2c44129edc033f59331e268bc
      path: modules/debug/segger
    - name: tinycbor
      path: modules/lib/tinycbor
      revision: 0fc68fceacd1efc1ce809c5880c380f3d98b7b6e
    - name: littlefs
      path: modules/fs/littlefs
      revision: fe9572dd5a9fcf93a249daa4233012692bd2881d
    - name: mipi-sys-t
      path: modules/debug/mipi-sys-t
      revision: baf51863f19f009b92e762115ba5572a5b996b92
    - name: nrf_hw_models
      path: modules/bsim_hw_models/nrf_hw_models
      revision: fec69703cb1ca06fcdab6d5fde01274f0fc5c759

  self:
    path: zephyr
    west-commands: scripts/west-commands.yml
```
